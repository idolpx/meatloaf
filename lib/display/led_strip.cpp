// Meatloaf - A Commodore 64/128 multi-device emulator
// https://github.com/idolpx/meatloaf
// Copyright(C) 2020 James Johnston
//
// Meatloaf is free software : you can redistribute it and/or modify
// it under the terms of the GNU General Public License as published by
// the Free Software Foundation, either version 3 of the License, or
// (at your option) any later version.
//
// Meatloaf is distributed in the hope that it will be useful,
// but WITHOUT ANY WARRANTY; without even the implied warranty of
// MERCHANTABILITY or FITNESS FOR A PARTICULAR PURPOSE. See the
// GNU General Public License for more details.
//
// You should have received a copy of the GNU General Public License
// along with Meatloaf. If not, see <http://www.gnu.org/licenses/>.

#ifdef ENABLE_DISPLAY

#include "led_strip.h"

// The Espressif led_strip component's public header is ALSO named led_strip.h,
// and lib/display is searched first, so it has to be reached by explicit path.
// led_strip_rmt.h is unambiguous (only the component has it).
#include "../../components/led_strip/include/led_strip.h"
#include "led_strip_rmt.h"

#include <stdio.h>
#include "freertos/FreeRTOS.h"
#include <freertos/queue.h>
#include "freertos/task.h"

#include "../../include/global_defines.h"
#include "../../include/pinmap.h"
#include "../../include/debug.h"
#include "../../include/cbm_defines.h"

#include "mlConfig.h"

//#include "WS2812FX/WS2812FX.h"


DisplayLEDs LEDS;

CRGB *ws28xx_pixels;
static int n_of_leds;

// RMT transport. WS2812 timing is generated by the component's encoder, so
// none of the old hand-rolled SPI bit-timing table is needed.
static led_strip_handle_t strip_handle = nullptr;
static int led_pin = -1;      // remembered so resize() can rebuild the device
static int led_model_cfg = 0; // ditto
led_strip_model_t led_model;




static void display_task(void *args)
{
    DisplayLEDs *d = (DisplayLEDs *)args;
    while (1) {
        d->service();
        vTaskDelay(d->speed / portTICK_PERIOD_MS);
    }
}

DisplayLEDs::DisplayLEDs()
{
    // Segment list and SPI mutex are deferred to start() to avoid
    // allocating from the C++ runtime heap before the system heap is ready.
    strip_mutex = nullptr;
}

static inline uint8_t scale_channel(uint8_t value, uint8_t brightness)
{
    return static_cast<uint8_t>((static_cast<uint16_t>(value) * brightness + 127) / 255);
}

void DisplayLEDs::service()
{
    if (m_pending_count >= 0) {
        resize(m_pending_count);
        m_pending_count = -1;
    }

    switch(mode)
    {
        case MODE_CLEAR:
            activity = false; progress = 100; speed = 1000; direction = 0;
            mode = MODE_IDLE;
            meatloaf();
            break;
        case MODE_IDLE:
        case MODE_SEND:
        case MODE_RECEIVE:
            // MODE_IDLE
            rotate();
            break;
        case MODE_STATUS:
            activity = false;
            switch( m_statusCode )
            {
                case ST_DISPLAY_OFF    :
                    // Set all leds to black
                    fill_all((CRGB){.r=0, .g=0, .b=0});
                    break;
                case ST_OK             :
                case ST_SCRATCHED      :
                case ST_DOSVERSION     :
                    mode = MODE_IDLE;
                    meatloaf();
                    break;
                default                :
                    blink();
                    break;
            }
            break;
        case MODE_CUSTOM:
            mode = MODE_IDLE;
            break;
    }
    if ( progress < 100 ) {
        show_progress();
    }
    else if ( activity ) {
        show_activity();
    }
    update();
}



// Create (or re-create) the RMT strip device for `count` LEDs on `gpio`.
// WS2815 is RGB-ordered; the WS2812 family is GRB.  The component's encoder
// owns the bit timing, which is what makes the old SPI timing table redundant.
static esp_err_t strip_device_create(int gpio, int count, int model)
{
    if (strip_handle != nullptr)
    {
        led_strip_del(strip_handle);
        strip_handle = nullptr;
    }

    led_strip_config_t strip_config = {};
    strip_config.strip_gpio_num = gpio;
    strip_config.max_leds = (count > 0) ? count : 1;
    strip_config.led_model = LED_MODEL_WS2812;
    strip_config.color_component_format = (model == WS2815)
        ? LED_STRIP_COLOR_COMPONENT_FMT_RGB
        : LED_STRIP_COLOR_COMPONENT_FMT_GRB;
    strip_config.flags.invert_out = false;

    led_strip_rmt_config_t rmt_config = {};
    rmt_config.clk_src = RMT_CLK_SRC_DEFAULT;
    rmt_config.resolution_hz = 10 * 1000 * 1000;   // 10 MHz, 0.1us per tick
    rmt_config.mem_block_symbols = 64;
    rmt_config.flags.with_dma = false;

    return led_strip_new_rmt_device(&strip_config, &rmt_config, &strip_handle);
}

esp_err_t DisplayLEDs::init(int pin, led_strip_model_t model, int num_of_leds)
{
    esp_err_t err = ESP_OK;
    n_of_leds = num_of_leds;
    led_model = model;
    // Increase if something breaks. values are less than recommended in
    // datasheets but seem stable
    ws28xx_pixels = (CRGB*)malloc(sizeof(CRGB) * (n_of_leds > 0 ? n_of_leds : RGB_LED_COUNT));
    if (ws28xx_pixels == NULL) {
        return ESP_ERR_NO_MEM;
    }

    // Per-pixel brightness is a NEUTRAL multiplier applied on top of the
    // global brightness (see update(): effective = per_led * brightness/255).
    // It must default to 255 (full), NOT the global brightness value — else
    // the two scalings compound and the global control can never reach max
    // (e.g. global 255 stays capped at the frozen per-pixel value).
    pixel_brightness.assign(n_of_leds, 255);

    err = strip_device_create(pin, n_of_leds, model);
    if (err != ESP_OK) {
        free(ws28xx_pixels);
        ws28xx_pixels = NULL;
        Debug_printv("led_strip_new_rmt_device failed: %s", esp_err_to_name(err));
        return err;
    }
    led_pin = pin;
    led_model_cfg = model;
    return ESP_OK;
}

// Runs on the display task (via service) so no other code touches the
// buffers mid-swap; the mutex still guards against a concurrent update()
bool DisplayLEDs::resize(int num_of_leds)
{
    if (num_of_leds == n_of_leds)
        return true;

    CRGB *new_pixels = (CRGB *)malloc(sizeof(CRGB) * (num_of_leds > 0 ? num_of_leds : 1));
    if (new_pixels == NULL) {
        Debug_printv("led resize failed count[%d]", num_of_leds);
        return false;
    }

    // The RMT device is sized by max_leds, so a count change means rebuilding
    // it.  Do that BEFORE swapping the pixel buffer: if it fails we still hold
    // a consistent strip at the old size.
    esp_err_t rerr = strip_device_create(led_pin, num_of_leds, led_model_cfg);
    if (rerr != ESP_OK) {
        free(new_pixels);
        Debug_printv("led resize: rmt rebuild failed: %s", esp_err_to_name(rerr));
        return false;
    }

    if (strip_mutex != nullptr)
        xSemaphoreTake(strip_mutex, portMAX_DELAY);
    free(ws28xx_pixels);
    ws28xx_pixels = new_pixels;
    n_of_leds = num_of_leds;
    if (strip_mutex != nullptr)
        xSemaphoreGive(strip_mutex);

    pixel_brightness.assign(num_of_leds, 255);  // neutral per-pixel multiplier (see init())
    fill_all((CRGB){.r=0, .g=0, .b=0});
    mode = MODE_CLEAR;  // repaint the idle pattern at the new size
    return true;
}

void DisplayLEDs::set_pixel(uint16_t index, CRGB color) { ws28xx_pixels[index] = color; };
void DisplayLEDs::set_pixel(uint16_t index, uint8_t r, uint8_t g, uint8_t b) { ws28xx_pixels[index] = (CRGB){.r=r, .g=g, .b=b}; };

void DisplayLEDs::set_pixels(uint16_t index, CRGB *colors, uint16_t count)
{
    if (colors == nullptr || index >= n_of_leds || count == 0)
        return;

    uint16_t available = static_cast<uint16_t>(n_of_leds - index);
    uint16_t length = (count < available) ? count : available;
    memcpy(&ws28xx_pixels[index], colors, sizeof(CRGB) * length);
}

void DisplayLEDs::set_brightness(uint8_t value)
{
    brightness = value;
}

void DisplayLEDs::set_pixel_brightness(uint16_t index, uint8_t value)
{
    if (index >= pixel_brightness.size())
        return;

    pixel_brightness[index] = value;
}

void DisplayLEDs::set_all_pixel_brightness(uint8_t value)
{
    for (size_t i = 0; i < pixel_brightness.size(); i++)
        pixel_brightness[i] = value;
}

void DisplayLEDs::set_segment(uint16_t index, CRGB color)
{
    if (index >= segments.size() || n_of_leds <= 0) {
        return;
    }

    int start = segments[index].first;
    int end = segments[index].second;

    if (start < 0) start = 0;
    if (start >= n_of_leds) return;
    if (end < start) end = start;
    if (end > n_of_leds) end = n_of_leds;

    for (int i = start; i < end; i++) {
        ws28xx_pixels[i] = color;
    }
}

void DisplayLEDs::fill_all(CRGB color) 
{
    for (int i = 0; i < n_of_leds; i++) {
        ws28xx_pixels[i] = color;
    }
}

void DisplayLEDs::show_activity()
{
    if (n_of_leds <= 0) {
        return;
    }

    static uint8_t curr_led = 3;
    if (curr_led >= n_of_leds) {
        curr_led = static_cast<uint8_t>(n_of_leds - 1);
    }

    // Set all leds to black
    fill_all((CRGB){.r=0, .g=0, .b=0});


    // Number of leds to light up
    ws28xx_pixels[curr_led] = (CRGB){.r=0, .g=100, .b=0};

    if ( direction)
        curr_led++;
    else
        curr_led--;

    if ( (curr_led == 0) )
        direction = 1;

    if (curr_led == (n_of_leds - 1))
        direction = 0;
}

void DisplayLEDs::show_progress()
{
    if (n_of_leds <= 0) {
        return;
    }

    static bool led_state_off = false;

    speed = 25;
    activity = false;

    // Set all leds to black
    fill_all((CRGB){.r=0, .g=0, .b=0});

    // Number of leds to light up
    uint8_t pct = progress;
    if (pct > 99) {
        pct = 99;
    }
    int n = (n_of_leds * pct) / 100;
    if (n >= n_of_leds) {
        n = n_of_leds - 1;
    }
    for (int i = 0; i < n; i++) {
        // rotate all elements of the array
        ws28xx_pixels[i] = (CRGB){.r=0, .g=100, .b=0};
    }

    led_state_off = !led_state_off;
    if (led_state_off) 
    {
        ws28xx_pixels[n] = (CRGB){.r=200, .g=200, .b=200};
    }
    else
    {
        ws28xx_pixels[n] = (CRGB){.r=0, .g=200, .b=0};
    }
    //if (n != 4)
    //    ws28xx_pixels[4] = (CRGB){.r=200, .g=200, .b=200};

    // Set remaining pixels to black
    // for (int i = n + 1; i < n_of_leds; i++) {
    //     ws28xx_pixels[i] = (CRGB){.r=0, .g=0, .b=0};
    // }
}

esp_err_t DisplayLEDs::update()
{
    if (strip_handle == nullptr)
        return ESP_ERR_INVALID_STATE;

    // The component's encoder owns WS2812 bit timing and the reset gap, so all
    // that survives here is the brightness scaling the old code did before
    // hand-encoding into the SPI DMA buffer.  Colour ORDER is set once at
    // device creation (RGB for WS2815, GRB otherwise), so r/g/b pass through in
    // their natural order rather than being shuffled per model every frame.
    esp_err_t err = ESP_OK;
    if (strip_mutex != nullptr && xSemaphoreTake(strip_mutex, portMAX_DELAY) != pdTRUE)
        return ESP_ERR_TIMEOUT;

    for (int i = 0; i < n_of_leds; i++) {
        uint8_t per_led = (i < pixel_brightness.size()) ? pixel_brightness[i] : 255;
        uint8_t effective_brightness = scale_channel(per_led, brightness);

        err = led_strip_set_pixel(strip_handle, i,
                                  scale_channel(ws28xx_pixels[i].r, effective_brightness),
                                  scale_channel(ws28xx_pixels[i].g, effective_brightness),
                                  scale_channel(ws28xx_pixels[i].b, effective_brightness));
        if (err != ESP_OK)
            break;
    }

    if (err == ESP_OK)
        err = led_strip_refresh(strip_handle);

    if (strip_mutex != nullptr)
        xSemaphoreGive(strip_mutex);

    return err;
}

void DisplayLEDs::start(void)
{
    int count = RGB_LED_COUNT;
    bool enabled = true;

    const psram_json &devices = mlConfig["devices"];
    if (devices.contains("led_strip"))
    {
        const psram_json &strip = devices["led_strip"];
        enabled = strip.value("enabled", 1) != 0;
        count = strip.value("count", (int)RGB_LED_COUNT);
        brightness = static_cast<uint8_t>(strip.value("brightness", (int)brightness));
    }

    if (!enabled)
    {
        Debug_printv("LED strip disabled in config");
        return;
    }

    if (count < 0) count = 0;
    if (count > 255) count = 255;

    if (init(PIN_LED_RGB, WS2812B, count) != ESP_OK)
    {
        Debug_printv("LED strip init failed; skipping DISPLAY task");
        return;
    }

    if (segments.empty()) {
        add_segment(0, 5);  // Default 5-LED segment, now safe to allocate
    }
    if (strip_mutex == nullptr) {
        strip_mutex = xSemaphoreCreateMutex();
    }
    idle();

    // Start DISPLAY task
    if ( xTaskCreatePinnedToCore(display_task, "display_rgb", 8192, this, 4, NULL, 0) != pdTRUE)
    {
        Debug_printv("Could not start DISPLAY task!");
    }
}

// Persist live settings into devices.led_strip. Mirrors iecDrive::persistConfig():
// mutate mlConfig only — the caller invokes mlConfig.save(). Preserves an
// existing "enabled" flag rather than clobbering it (the strip has no runtime
// enable/disable, so it's owned by config). A pending count from set_count()
// that the display task hasn't applied yet is persisted in preference to the
// stale live n_of_leds.
void DisplayLEDs::persistConfig()
{
    auto &entry = mlConfig.data()["devices"]["led_strip"];
    if (!entry.contains("enabled"))
        entry["enabled"] = 1;
    entry["count"] = (m_pending_count >= 0) ? m_pending_count : n_of_leds;
    entry["brightness"] = brightness;
}

// Apply devices.led_strip settings from mlConfig to the live strip. Only the
// runtime-adjustable settings (brightness, count) are applied; "enabled" is
// honored solely at start() since there is no clean way to tear down/recreate
// the display task here. count goes through set_count() so the actual buffer
// resize happens on the display task's next pass (never from the caller's task).
bool DisplayLEDs::reloadConfig()
{
    const psram_json &devices = mlConfig["devices"];
    if (!devices.contains("led_strip"))
        return false;

    const psram_json &strip = devices["led_strip"];
    set_brightness(static_cast<uint8_t>(strip.value("brightness", (int)brightness)));

    int count = strip.value("count", n_of_leds);
    if (count < 0) count = 0;
    if (count > 255) count = 255;
    set_count(static_cast<uint8_t>(count));

    return true;
}


void DisplayLEDs::blink(void)
{
    static bool led_state_off = false;
    speed = 100;

    led_state_off = !led_state_off;
    for(int i = 0; i < n_of_leds; i++) {
        if (led_state_off) 
            ws28xx_pixels[i] = (CRGB){.r=0, .g=0, .b=0};
        else 
            ws28xx_pixels[i] = (CRGB){.r=20, .g=0, .b=0};
    }
}

void DisplayLEDs::rotate()
{
    if (n_of_leds <= 1) {
        return;
    }

    if ( !direction )
    {
        // rotate left
        auto temp = ws28xx_pixels[0];
        memmove(ws28xx_pixels, ws28xx_pixels + 1, sizeof(CRGB) * (n_of_leds - 1));
        ws28xx_pixels[n_of_leds - 1] = temp;
    }
    else
    {
        // rotate right
        auto temp = ws28xx_pixels[n_of_leds - 1];
        memmove(ws28xx_pixels + 1, ws28xx_pixels, sizeof(CRGB) * (n_of_leds - 1));
        ws28xx_pixels[0] = temp;
    }
    memcpy(ws28xx_pixels, ws28xx_pixels, sizeof(CRGB) * n_of_leds);

}

void DisplayLEDs::meatloaf()
{
    if (n_of_leds <= 0) {
        return;
    }

    // Pastel Meatloaf Pixels
    if (n_of_leds > 0) ws28xx_pixels[0] = (CRGB){.r=87, .g=145, .b=178};   // BLUE
    if (n_of_leds > 1) ws28xx_pixels[1] = (CRGB){.r=128, .g=178, .b=58};   // GREEN
    if (n_of_leds > 2) ws28xx_pixels[2] = (CRGB){.r=178, .g=168, .b=58};   // YELLOW
    if (n_of_leds > 3) ws28xx_pixels[3] = (CRGB){.r=178, .g=102, .b=51};   // ORANGE
    if (n_of_leds > 4) ws28xx_pixels[4] = (CRGB){.r=178, .g=61, .b=53};    // RED

    // // Vibrant Meatloaf Pixels
    // ws28xx_pixels[0] = (CRGB){.r=0, .g=0, .b=255};   // BLUE
    // ws28xx_pixels[1] = (CRGB){.r=0, .g=255, .b=0};   // GREEN
    // ws28xx_pixels[2] = (CRGB){.r=255, .g=255, .b=0};   // YELLOW
    // ws28xx_pixels[3] = (CRGB){.r=255, .g=114, .b=0};   // ORANGE
    // ws28xx_pixels[4] = (CRGB){.r=255, .g=0, .b=0};    // RED

    update();
}


#endif // ENABLE_DISPLAY