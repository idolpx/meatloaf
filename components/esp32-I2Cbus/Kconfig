## components/esp32-I2Cbus/Kconfig
```kconfig
menu "I2Cbus"

config I2CBUS_LOG_ERRORS
    bool "Log fail read/write operations (errors)"
    depends on ! LOG_DEFAULT_LEVEL_NONE
    default "y"
    help
        Log any read/write operation errors that might ocurr within I2Cbus library.

config I2CBUS_LOG_READWRITES
    bool "Log successuful read/write operations (debug)"
    depends on ! LOG_DEFAULT_LEVEL_NONE && ! LOG_DEFAULT_LEVEL_ERROR && ! LOG_DEFAULT_LEVEL_WARN
    default "n"
    help
        Log all successuful read/write data, including port, slave address, 
        target register and the data written to. Useful for debugging.

choice
    prompt "Log level"
    depends on I2CBUS_LOG_READWRITES
    default I2CBUS_LOG_RW_LEVEL_VERBOSE
    help
        Log level for successuful read/write operations. Levels depends on LOG_DEFAULT_LEVEL.

config I2CBUS_LOG_RW_LEVEL_INFO
    bool "Info"
config I2CBUS_LOG_RW_LEVEL_DEBUG
    bool "Debug"
config I2CBUS_LOG_RW_LEVEL_VERBOSE
    bool "Verbose"
endchoice

endmenu
```

## components/psramfs/Kconfig
```kconfig
menu "PSRAMFS Configuration"

    config PSRAMFS_MAX_PARTITIONS
        int "Maximum Number of Partitions"
        default 3
        range 1 10
        help
            Define maximum number of partitions that can be mounted.

    menu "PSRAMFS Cache Configuration"
        config PSRAMFS_CACHE
            bool "Enable PSRAMFS Cache"
            default "y"
            help
                Enables/disable memory read caching of nucleus file system
                operations.

        config PSRAMFS_CACHE_WR
            bool "Enable PSRAMFS Write Caching"
            default "y"
            depends on PSRAMFS_CACHE
            help
                Enables memory write caching for file descriptors in hydrogen.

        config PSRAMFS_CACHE_STATS
            bool "Enable PSRAMFS Cache Statistics"
            default "n"
            depends on PSRAMFS_CACHE
            help
                Enable/disable statistics on caching. Debug/test purpose only.

    endmenu

    config PSRAMFS_PAGE_CHECK
        bool "Enable PSRAMFS Page Check"
        default "y"
        help
            Always check header of each accessed page to ensure consistent state.
            If enabled it will increase number of reads from flash, especially
            if cache is disabled.

    config PSRAMFS_GC_MAX_RUNS
        int "Set Maximum GC Runs"
        default 10
        range 1 10000
        help
            Define maximum number of GC runs to perform to reach desired free pages.

    config PSRAMFS_GC_STATS
        bool "Enable PSRAMFS GC Statistics"
        default "n"
        help
            Enable/disable statistics on gc. Debug/test purpose only.

    config PSRAMFS_PAGE_SIZE
        int "PSRAMFS logical page size"
        default 256
        range 256 1024
        help
            Logical page size of PSRAMFS partition, in bytes. Must be multiple
            of flash page size (which is usually 256 bytes).
            Larger page sizes reduce overhead when storing large files, and
            improve filesystem performance when reading large files.
            Smaller page sizes reduce overhead when storing small (< page size)
            files.

    config PSRAMFS_OBJ_NAME_LEN
        int "Set PSRAMFS Maximum Name Length"
        default 32
        range 1 256
        help
            Object name maximum length. Note that this length include the
            zero-termination character, meaning maximum string of characters
            can at most be PSRAMFS_OBJ_NAME_LEN - 1.

            PSRAMFS_OBJ_NAME_LEN + PSRAMFS_META_LENGTH should not exceed
            PSRAMFS_PAGE_SIZE - 64.

    config PSRAMFS_FOLLOW_SYMLINKS
        bool "Enable symbolic links for image creation"
        default "n"
        help
            If this option is enabled, symbolic links are taken into account
            during partition image creation.

    config PSRAMFS_USE_MAGIC
        bool "Enable PSRAMFS Filesystem Magic"
        default "n"
        help
            Enable this to have an identifiable psram filesystem.
            This will look for a magic in all sectors to determine if this
            is a valid psram system or not at mount time.

    config PSRAMFS_USE_MAGIC_LENGTH
        bool "Enable PSRAMFS Filesystem Length Magic"
        default "n"
        depends on PSRAMFS_USE_MAGIC
        help
            If this option is enabled, the magic will also be dependent
            on the length of the filesystem. For example, a filesystem
            configured and formatted for 4 megabytes will not be accepted
            for mounting with a configuration defining the filesystem as 2 megabytes.

    config PSRAMFS_META_LENGTH
        int "Size of per-file metadata field"
        default 4
        help
            This option sets the number of extra bytes stored in the file header.
            These bytes can be used in an application-specific manner.
            Set this to at least 4 bytes to enable support for saving file
            modification time.

            PSRAMFS_OBJ_NAME_LEN + PSRAMFS_META_LENGTH should not exceed
            PSRAMFS_PAGE_SIZE - 64.

    config PSRAMFS_USE_MTIME
        bool "Save file modification time"
        default "y"
        depends on PSRAMFS_META_LENGTH >= 4
        help
            If enabled, then the first 4 bytes of per-file metadata will be used
            to store file modification time (mtime), accessible through
            stat/fstat functions.
            Modification time is updated when the file is opened.

    config PSRAMFS_MTIME_WIDE_64_BITS
        bool "The time field occupies 64 bits in the image instead of 32 bits"
        default n
        depends on PSRAMFS_META_LENGTH >= 8
        help
            If this option is not set, the time field is 32 bits (up to 2106 year),
            otherwise it is 64 bits and make sure it matches PSRAMFS_META_LENGTH.
            If the chip already has the psram image with the time field = 32 bits
            then this option cannot be applied in this case.
            Erase it first before using this option.
            To resolve the Y2K38 problem for the psram, use a toolchain with
            64-bit time_t support.

    menu "Debug Configuration"

        config PSRAMFS_DBG
            bool "Enable general PSRAMFS debug"
            default "n"
            help
                Enabling this option will print general debug mesages to the console.

        config PSRAMFS_API_DBG
            bool "Enable PSRAMFS API debug"
            default "n"
            help
                Enabling this option will print API debug mesages to the console.

        config PSRAMFS_GC_DBG
            bool "Enable PSRAMFS Garbage Cleaner debug"
            default "n"
            help
                Enabling this option will print GC debug mesages to the console.

        config PSRAMFS_CACHE_DBG
            bool "Enable PSRAMFS Cache debug"
            default "n"
            depends on PSRAMFS_CACHE
            help
                Enabling this option will print cache debug mesages to the console.

        config PSRAMFS_CHECK_DBG
            bool "Enable PSRAMFS Filesystem Check debug"
            default "n"
            help
                Enabling this option will print Filesystem Check debug mesages
                to the console.

        config PSRAMFS_TEST_VISUALISATION
            bool "Enable PSRAMFS Filesystem Visualization"
            default "n"
            help
                Enable this option to enable PSRAMFS_vis function in the API.

    endmenu

endmenu
```
